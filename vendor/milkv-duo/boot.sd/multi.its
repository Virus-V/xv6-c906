## vendor/milkv-duo/boot.sd/multi.its
```
/*
 * U-Boot uImage source file with multiple kernels, ramdisks and FDT blobs
 */

/dts-v1/;

/ {
  description = "Various kernels, ramdisks and FDT blobs";
  #address-cells = <2>;

  images {
    kernel-1 {
      description = "cvitek kernel";
      data = /incbin/("./kernel.bin.lzma");
      type = "kernel";
      arch = "riscv";
      os = "linux";
      compression = "lzma";
      load = <0x0 0x80080000>;
      entry = <0x0 0x80080000>;
      hash-2 {
        algo = "crc32";
      };
    };

    ramdisk-1 {
      description = "cvitek ramdisk";
      data = /incbin/("./fs.img");
      type = "ramdisk";
      arch = "riscv";
      os = "linux";
      compression = "none";
      load = <0x0 0x80280000>;
      hash-1 {
        algo = "crc32";
      };
    };

    /*FDT*/
    fdt-cv1800b_milkv_duo_sd {
      description = "cvitek device tree - cv1800b_milkv_duo_sd";
      data = /incbin/("./cv1800b_milkv_duo_sd.dtb");
      type = "flat_dt";
      arch = "riscv";
      compression = "none";
      hash-1 {
        algo = "sha256";
      };
    };
  };

  /*CFG*/
  configurations {
    config-cv1800b_milkv_duo_sd {
      description = "boot cvitek system with board cv1800b_milkv_duo_sd";
      kernel = "kernel-1";
      ramdisk = "ramdisk-1";
      fdt = "fdt-cv1800b_milkv_duo_sd";
    };
  };
};
```
